## Kconfig
```kconfig
mainmenu "Emux Configuration"

config EMUX_SRC_DIR
	string
	option env="EMUX_SRC_DIR"

source "$EMUX_SRC_DIR/mach/Kconfig"
source "$EMUX_SRC_DIR/frontends/Kconfig"
source "$EMUX_SRC_DIR/controllers/Kconfig"
source "$EMUX_SRC_DIR/cpu/Kconfig"

config CMDLINE
	string "Default command string"
	default ""
	help
		This option can be modified in order to allow, extend or force
		Emux command line arguments, which may be desired or required
		for certain project configurations.

choice
	prompt "Command line type" if CMDLINE != ""
	default CMDLINE_FROM_ARGS

config CMDLINE_FROM_ARGS
	bool "Use arguments if available"
	help
		Uses the command-line options passed as arguments to Emux. If
		none is specified, the default command string provided in
		CMDLINE will be used.

config CMDLINE_EXTEND
	bool "Extend arguments"
	help
		The command line arguments provided to Emux will be appended
		to the default command string.

config CMDLINE_FORCE
	bool "Always use the default command string"
	help
		Always use the default command string, even when specifying
		arguments at run-time. This is useful if you can't or don't want
		to change the command line options passed to Emux.
endchoice
```

## controllers/Kconfig
```kconfig
menu "Controller selection"

source "$EMUX_SRC_DIR/controllers/audio/Kconfig"
source "$EMUX_SRC_DIR/controllers/dma/Kconfig"
source "$EMUX_SRC_DIR/controllers/input/Kconfig"
source "$EMUX_SRC_DIR/controllers/mapper/Kconfig"
source "$EMUX_SRC_DIR/controllers/serial/Kconfig"
source "$EMUX_SRC_DIR/controllers/timer/Kconfig"
source "$EMUX_SRC_DIR/controllers/video/Kconfig"

endmenu
```

## controllers/audio/Kconfig
```kconfig
menu "Audio"

config CONTROLLER_AUDIO_APU
	bool "NES APU"
	default y
	help
		Enable NES audio processing unit

config CONTROLLER_AUDIO_PAPU
	bool "GB PAPU"
	default y
	help
		Enable Game Boy PAPU sound chip

config CONTROLLER_AUDIO_SN76489
	bool "SN76489"
	default y
	help
		Enable SN76489 sound chip

config CONTROLLER_AUDIO_SPU
	bool "PSX SPU"
	default y
	help
		Enable PSX sound processing unit

endmenu
```

## controllers/cdrom/Kconfig
```kconfig
menu "CD-ROM"

config CONTROLLER_CDROM
	bool
	default n

config CONTROLLER_CDROM_PSX
	bool "PSX CD-ROM controller"
	select CONTROLLER_CDROM
	default y
	help
		Enable PSX CD-ROM support

endmenu
```

## controllers/dma/Kconfig
```kconfig
menu "DMA"

config CONTROLLER_DMA_NES
	bool "NES Sprite DMA controller"
	default y
	help
		Enable NES sprite DMA operations

config CONTROLLER_DMA_PSX
	bool "PSX DMA controller"
	default y
	help
		Enable PSX DMA controller

endmenu
```

## controllers/input/Kconfig
```kconfig
menu "Input"

config CONTROLLER_INPUT_GB
	bool "GB joypad"
	default y
	help
		Enable GB joypad

config CONTROLLER_INPUT_NES
	bool "NES standard controller"
	default y
	help
		Enable NES standard controller for players 1 and 2

config CONTROLLER_INPUT_SMS
	bool "SMS controller"
	default y
	help
		Enable SMS peripheral support

config CONTROLLER_INPUT_PSX
	bool "PSX controller and memory card"
	default y
	help
		Enable PSX controller and memory card I/O

endmenu
```

## controllers/mapper/Kconfig
```kconfig
menu "Mappers"

config CONTROLLER_MAPPER_GB
	bool "GB"
	default y
	help
		Enable GB mapper

config CONTROLLER_MAPPER_MBC1
	bool "MBC1"
	depends on CONTROLLER_MAPPER_GB
	default y
	help
		Enable GB MBC1 cartridge type

config CONTROLLER_MAPPER_ROM
	bool "ROM"
	depends on CONTROLLER_MAPPER_GB
	default y
	help
		Enable GB ROM ONLY cartridge type

config CONTROLLER_MAPPER_NES
	bool "NES"
	default y
	help
		Enable NES mapper

config CONTROLLER_MAPPER_MMC1
	bool "MMC1"
	depends on CONTROLLER_MAPPER_NES
	default y
	help
		Enable NES MMC1 mapper

config CONTROLLER_MAPPER_MMC3
	bool "MMC3"
	depends on CONTROLLER_MAPPER_NES
	default y
	help
		Enable NES MMC3 mapper

config CONTROLLER_MAPPER_NROM
	bool "NROM"
	depends on CONTROLLER_MAPPER_NES
	default y
	help
		Enable NES NROM - No Mapper (or unknown mapper)

config CONTROLLER_MAPPER_SMS
	bool "SMS"
	default y
	help
		Enable SMS mapper

config CONTROLLER_MAPPER_SEGA
	bool "SMS"
	depends on CONTROLLER_MAPPER_SMS
	default y
	help
		Enable SEGA mapper

endmenu
```

## controllers/media/Kconfig
```kconfig
menu "Media"

config CONTROLLER_MEDIA_MDEC
	bool "PSX MDEC"
	default y
	help
		Enable PSX MDEC (Motion Decoder)

endmenu
```

## controllers/serial/Kconfig
```kconfig
menu "Serial"

config CONTROLLER_SERIAL_GB
	bool "GB"
	default y
	help
		Enable GB serial support

endmenu
```

## controllers/timer/Kconfig
```kconfig
menu "Timers"

config CONTROLLER_TIMER_GB
	bool "GB"
	default y
	help
		Enable GB timer

config CONTROLLER_TIMER_PSX
	bool "PSX"
	default y
	help
		Enable PSX timers

endmenu
```

## controllers/video/Kconfig
```kconfig
menu "Video"

config CONTROLLER_VIDEO_LCDC
	bool "GB LCDC"
	default y
	help
		Enable Game Boy LCD controller

config CONTROLLER_VIDEO_PPU
	bool "NES PPU"
	default y
	help
		Enable NES PPU (Picture Processing Unit)

config CONTROLLER_VIDEO_VDP
	bool "SMS VDP"
	default y
	help
		Enable SMS VDP (Video Display Processor)

endmenu
```

## cpu/Kconfig
```kconfig
menu "CPU selection"

config CPU_CHIP8
	bool "CHIP8"
	default y
	help
		Enable CHIP-8 CPU

config CPU_LR35902
	bool "LR35902"
	default y
	help
		Enable LR35902 CPU

config CPU_R3051
	bool "R3051"
	default y
	help
		Enable R3051 CPU

config CPU_RP2A03
	bool "RP2A03"
	default y
	help
		Enable RP2A03 CPU

config CPU_Z80
	bool "Z80"
	default y
	help
		Enable Z80 CPU

endmenu
```

## frontends/Kconfig
```kconfig
menu "Frontend selection"

source "$EMUX_SRC_DIR/frontends/audio/Kconfig"
source "$EMUX_SRC_DIR/frontends/input/Kconfig"
source "$EMUX_SRC_DIR/frontends/video/Kconfig"

endmenu
```

## frontends/audio/Kconfig
```kconfig
menu "Audio frontend selection"

config AUDIO_SDL
	bool "sdl"
	default y
	help
		Enable SDL (Simple DirectMedia Layer) audio frontend

endmenu
```

## frontends/cdrom/Kconfig
```kconfig
menu "CD-ROM frontend selection"

config CDROM_CDIO
	bool "cdio"
	default y
	help
		Enable libcdio (GNU Compact Disc Input and Control library)
		CD-ROM frontend

endmenu
```

## frontends/input/Kconfig
```kconfig
menu "Input frontend configuration"

config INPUT_CACA
	bool "caca"
	default n
	help
		Enable libcaca input frontend

config INPUT_SDL
	bool "sdl"
	default y
	help
		Enable SDL (Simple DirectMedia Layer) input frontend

config INPUT_XML
	bool "XML input configuration"
	default n
	help
		Add support for XML input configuration

endmenu
```

## frontends/video/Kconfig
```kconfig
menu "Video frontend selection"

config VIDEO_CACA
	bool "caca"
	default n
	help
		Enable libcaca video frontend

config VIDEO_OPENGL
	bool "opengl"
	default n
	help
		Enable OpenGL video frontend (through SDL)

config VIDEO_SDL
	bool "sdl"
	default y
	help
		Enable SDL (Simple DirectMedia Layer) software video frontend

endmenu
```

## mach/Kconfig
```kconfig
menu "Machine selection"

config MACH
	bool
	default n

config MACH_CHIP8
	bool "chip8 (CHIP-8)"
	select MACH
	select CPU_CHIP8
	default y
	help
		Enable CHIP-8 support

config MACH_GB
	bool "gb (Nintendo Game Boy)"
	select MACH
	select CPU_LR35902
	select CONTROLLER_AUDIO_PAPU
	select CONTROLLER_INPUT_GB
	select CONTROLLER_MAPPER_GB
	select CONFIG_CONTROLLER_MAPPER_MBC1
	select CONFIG_CONTROLLER_MAPPER_ROM
	select CONTROLLER_SERIAL_GB
	select CONTROLLER_TIMER_GB
	select CONTROLLER_VIDEO_LCDC
	default y
	help
		Enable GB (Nintendo Game Boy) support

config MACH_NES
	bool "nes (Nintendo Entertainment System)"
	select MACH
	select CPU_RP2A03
	select CONTROLLER_AUDIO_APU
	select CONTROLLER_DMA_NES
	select CONTROLLER_INPUT_NES
	select CONFIG_CONTROLLER_MAPPER_MMC1
	select CONFIG_CONTROLLER_MAPPER_MMC3
	select CONTROLLER_MAPPER_NES
	select CONFIG_CONTROLLER_MAPPER_NROM
	select CONTROLLER_VIDEO_PPU
	default y
	help
		Enable NES (Nintendo Entertainment System) support

config MACH_PSX
	bool "psx (Sony PlayStation)"
	select MACH
	select CPU_R3051
	select CONTROLLER_AUDIO_SPU
	select CONTROLLER_CDROM_PSX
	select CONTROLLER_DMA_PSX
	select CONTROLLER_INPUT_PSX
	select CONTROLLER_MEDIA_MDEC
	select CONTROLLER_TIMER_PSX
	select CONTROLLER_VIDEO_GPU
	default y
	help
		Enable PSX (Sony PlayStation) support

config MACH_SMS
	bool "sms (Sega Master System)"
	select MACH
	select CPU_Z80
	select CONTROLLER_AUDIO_SN76489
	select CONTROLLER_INPUT_SMS
	select CONTROLLER_MAPPER_SMS
	select CONTROLLER_MAPPER_SEGA
	select CONTROLLER_VIDEO_VDP
	default y
	help
		Enable SMS (Sega Master System) support

endmenu
```

## mach/configs/all_defconfig
```kconfig
CONFIG_MACH=y
CONFIG_MACH_CHIP8=y
CONFIG_MACH_GB=y
CONFIG_MACH_NES=y
CONFIG_MACH_SMS=y
CONFIG_AUDIO_SDL=y
CONFIG_INPUT_SDL=y
CONFIG_VIDEO_SDL=y
CONFIG_CONTROLLER_AUDIO_PAPU=y
CONFIG_CONTROLLER_DMA_NES=y
CONFIG_CONTROLLER_INPUT_GB=y
CONFIG_CONTROLLER_INPUT_NES=y
CONFIG_CONTROLLER_MAPPER_GB=y
CONFIG_CONTROLLER_MAPPER_MBC1=y
CONFIG_CONTROLLER_MAPPER_ROM=y
CONFIG_CONTROLLER_MAPPER_NES=y
CONFIG_CONTROLLER_MAPPER_NROM=y
CONFIG_CONTROLLER_MAPPER_SMS=y
CONFIG_CONTROLLER_SERIAL_GB=y
CONFIG_CONTROLLER_TIMER_GB=y
CONFIG_CONTROLLER_VIDEO_LCDC=y
CONFIG_CONTROLLER_VIDEO_PPU=y
CONFIG_CONTROLLER_VIDEO_VDP=y
CONFIG_CPU_CHIP8=y
CONFIG_CPU_LR35902=y
CONFIG_CPU_RP2A03=y
CONFIG_CPU_Z80=y
```

## mach/configs/chip8_defconfig
```kconfig
CONFIG_MACH=y
CONFIG_MACH_CHIP8=y
CONFIG_AUDIO_SDL=y
CONFIG_INPUT_SDL=y
CONFIG_VIDEO_SDL=y
CONFIG_CPU_CHIP8=y
```

## mach/configs/gb_defconfig
```kconfig
CONFIG_MACH=y
CONFIG_MACH_GB=y
CONFIG_AUDIO_SDL=y
CONFIG_INPUT_SDL=y
CONFIG_VIDEO_SDL=y
CONFIG_CONTROLLER_AUDIO_PAPU=y
CONFIG_CONTROLLER_INPUT_GB=y
CONFIG_CONTROLLER_MAPPER_GB=y
CONFIG_CONTROLLER_MAPPER_MBC1=y
CONFIG_CONTROLLER_MAPPER_MBC2=y
CONFIG_CONTROLLER_MAPPER_ROM=y
CONFIG_CONTROLLER_SERIAL_GB=y
CONFIG_CONTROLLER_TIMER_GB=y
CONFIG_CONTROLLER_VIDEO_LCDC=y
CONFIG_CPU_LR35902=y
```

## mach/configs/nes_defconfig
```kconfig
CONFIG_MACH=y
CONFIG_MACH_NES=y
CONFIG_AUDIO_SDL=y
CONFIG_INPUT_SDL=y
CONFIG_VIDEO_SDL=y
CONFIG_CONTROLLER_AUDIO_APU=y
CONFIG_CONTROLLER_DMA_NES=y
CONFIG_CONTROLLER_INPUT_NES=y
CONFIG_CONTROLLER_MAPPER_MMC3=y
CONFIG_CONTROLLER_MAPPER_NES=y
CONFIG_CONTROLLER_MAPPER_NROM=y
CONFIG_CONTROLLER_VIDEO_PPU=y
CONFIG_CPU_RP2A03=y
```

## mach/configs/psx_defconfig
```kconfig
CONFIG_MACH=y
CONFIG_MACH_PSX=y
CONFIG_AUDIO_SDL=y
CONFIG_CDROM_CDIO=y
CONFIG_INPUT_SDL=y
CONFIG_VIDEO_SDL=y
CONFIG_CONTROLLER_AUDIO_SPU=y
CONFIG_CONTROLLER_CDROM_PSX=y
CONFIG_CONTROLLER_DMA_PSX=y
CONFIG_CONTROLLER_INPUT_PSX=y
CONFIG_CONTROLLER_MEDIA_MDEC=y
CONFIG_CONTROLLER_TIMER_PSX=y
CONFIG_CONTROLLER_VIDEO_GPU=y
CONFIG_CPU_R3051=y
```

## mach/configs/sms_defconfig
```kconfig
CONFIG_MACH=y
CONFIG_MACH_SMS=y
CONFIG_AUDIO_SDL=y
CONFIG_INPUT_SDL=y
CONFIG_VIDEO_SDL=y
CONFIG_CONTROLLER_AUDIO_SN76489=y
CONFIG_CONTROLLER_INPUT_SMS=y
CONFIG_CONTROLLER_MAPPER_SMS=y
CONFIG_CONTROLLER_MAPPER_SEGA=y
CONFIG_CONTROLLER_VIDEO_VDP=y
CONFIG_CPU_Z80=y
```
